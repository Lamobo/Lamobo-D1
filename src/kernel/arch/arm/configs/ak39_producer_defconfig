## src/kernel/arch/arm/mach-ak39/Kconfig
```kconfig
# linux/arch/arm/mach-ak39/Kconfig
#
# Copyright 2013 Anaka Microelectronics
#
# Licensed under GPLv2
 
# define CPU TYPE FLAGS 
config CPU_AK3910
	bool
config CPU_AK3916
	bool
config CPU_AK3918
	bool

# Machine support
choice
	prompt "ANYKA AK39xx boards"
	default ARCH_SDK3910
	depends on ARCH_AK39

config ARCH_SDK3910
	bool "SDK3910"
	depends on ARCH_AK39
	select CPU_AK3910
	help
	  Say Y here if you are using the SDK3910(Athena v2 borad) on chip AK3910

config ARCH_AIMER39_AK3916
	bool "Aimer39 AK3916 board"
	depends on ARCH_AK39
	select CPU_AK3916
	help
	  Say Y here if you are using the Aimer39_AK3916_MB_v1.0.0 board on chip AK3916

config ARCH_AIMER39_AK3918
	bool "Aimer39 AK3918 board"
	depends on ARCH_AK39
	select CPU_AK3918
	help
	  Say Y here if you are using the Aimer39_AK3918_MB_v1.0.0 board on chip AK3918

endchoice

# aisc cpufreq set
config ASIC_FREQ_VALUE
	int "Config asic frequency(if asic>100MHz asic=vclk; else asic=vclk/2)"
	range 45000000 120000000
	default 90000000
	depends on ARCH_AK39
	help
	  config ak39xx asic frequency when the kernel uncompress.
	  note: vclk be equal to even asic.

# power managerment
comment "Power management"
config AK39_PM
	bool "ak39 Power Management support"
	depends on PM && ARCH_AK39
	help
	Say Y here if you want support power management for AK39.

config AK39_CPUFREQ
	bool "ak39 Frequency scaling support"
	depends on CPU_FREQ && ARCH_AK39
	help
	  Say Y here, CPU Frequency scaling support for AK39 SoC CPUs.

# chip extra controller lib
config AK39_PWM_TIMER
	bool "ak39 PWM/Timer Control support"
	depends on ARCH_AK39
	help
	  Say Y here if you want support pwm control.
```

## src/kernel/arch/arm/plat-anyka/Kconfig
```kconfig
# arch/arm/plat-anyka/Kconfig
#
# Copyright 2012 Anaka Microelectronics
#
# Licensed under GPLv2

config PLAT_ANYKA
	bool
	depends on ARCH_AK39
	default y
	help
	  Base platform code for ak39xx chips common device

# low-level serial option nodes
```

## src/kernel/drivers/media/video/plat-anyka/Kconfig
```kconfig
config SENSOR_GC0308
	tristate "gc0308 sensor support"
	depends on LINUX_AKSENSOR
	help
	  This is a gc0308 sensor driver
	  
config SENSOR_OV2643
	tristate "ov2643 sensor support"
	depends on LINUX_AKSENSOR
	help
	  This is a ov2643 sensor driver
	  
config SENSOR_OV7725
	tristate "ov7725 sensor support"
	depends on LINUX_AKSENSOR
	help
	  This is a ov7725 sensor driver
	  
config SENSOR_HM1375
	tristate "hm1375 sensor support"
	depends on LINUX_AKSENSOR
	help
	  This is a hm1375 sensor driver
	  
config SENSOR_OV9712
	tristate "ov9712 sensor support"
	depends on LINUX_AKSENSOR
	help
	  This is a ov9712 sensor driver
	  
config SENSOR_OV2710
	tristate "ov2710 sensor support"
	depends on LINUX_AKSENSOR
	help
	  This is a ov2710 sensor driver

config SENSOR_AR0130
	tristate "ar0130 sensor support"
	depends on LINUX_AKSENSOR
	help
	  This is a ar0130 sensor driver

config SENSOR_H22
	tristate "jx-h22 sensor support"
	depends on LINUX_AKSENSOR
	help
	  This is a jx-h22 sensor driver

config SENSOR_NT99141
	tristate "nt99141 sensor support"
	depends on LINUX_AKSENSOR
	help
	  This is a nt99141 sensor driver
```

## src/kernel/drivers/net/ethernet/ak-ethernet/Kconfig
```kconfig
config AK_ETHERNET
	tristate "Anyka Ethernet support"
	depends on ARCH_AK39
	help
	  Anyka  Ethernet device support
```

## src/kernel/drivers/usb/gadget/plat-anyka/Kconfig
```kconfig
config USB_GADGET_AKUDC_PRODUCER
	bool "Anyka usb device Port for PRODUCER"
	depends on ARCH_AK39
	select USB_GADGET_DUALSPEED
	help
	  Anyka USB-OTG device support for producer

if USB_GADGET_AKUDC_PRODUCER
config USB_AKUDC_PRODUCER
	tristate
	default y
endif

config USB_GADGET_AKUDC
	bool "Anyka usb device Port"
	depends on ARCH_AK39
	select USB_GADGET_DUALSPEED
	help
	  Anyka USB-OTG gadget device support

config USB_AKUDC
	tristate "udc driver support(usb-otg)"
	depends on USB_GADGET_AKUDC
	default USB_GADGET
	help
	  udc driver in ak39xx platfrom

config USB_AKUDC_DEBUG_FS
	bool "Debugging information files (DEVELOPMENT)"
	depends on USB_AKUDC
	help
	  Some of the drivers in the "gadget" framework can expose debugging information 
	  in files such as /proc/driver/udc (for a peripheral controller).  The information in these
	  files may help when you're troubleshooting or bringing up a driver on a new board.

	  Enable these files by choosing "Y" here.  If in doubt, or to conserve kernel memory, say "N".
```

## src/kernel/drivers/usb/host/plat-anyka/Kconfig
```kconfig
config USB_ANYKA_HCD
	bool "Anyka on-chip HCD support"
	depends on USB && ARCH_AK39
	help
	  Enable support for the ANYKA on-chip HCD, It is support full speed and high speed

config USB_AKOTG_HS_HCD
	tristate "USB(otg) High-Speed HCD support"
	depends on USB_ANYKA_HCD
	help
	  The ANYKA chips inner USB otg high speed host controllers. Enable this
	  option if your board has this chip. If unsure, say N.
	  
	  This driver does not support isochronous transfers.
	  
	  To compile this driver as a module, choose M here: the
	  module will be called otg-hs.

config USB_AKOTG_DMA
    bool "USB(otg) support for DMA transfer"
	depends on USB_AKOTG_HS_HCD
	help
	  Say 'Y' to turn on dma support for anyka otg host.
	  
	  If no need, say N.
```

## src/kernel/sound/arm/Kconfig
```kconfig
# ALSA ARM drivers

menuconfig SND_ARM
	bool "ARM sound devices"
	depends on ARM
	default y
	help
	  Support for sound devices specific to ARM architectures.
	  Drivers that are implemented on ASoC can be found in
	  "ALSA for SoC audio support" section.

if SND_ARM

config SND_AK_PCM
   tristate "Anyka ADC/DAC sound driver"
   select SND_PCM
   help
	  ALSA sound driver fo the AK ADC/DAC.
	  
choice
	prompt "Select codec"
	depends on SND_AK_PCM

config CODEC_AK39
	bool "AK39 internal codec"
	depends on SND_AK_PCM
	help
	  ak39 SoC audio codec.
	  	  
endchoice
	  	  
choice
	prompt "HP/Speaker switch mode"
	depends on SND_AK_PCM
	
config SPKHP_SWITCH_AUTO
	bool "auto switch in audio driver(default, for both linux and android)"

config SPKHP_SWITCH_MIXER
	bool "notify,but not switch in audio driver(with ALSA lib amixer)"

config SPKHP_SWITCH_UEVENT
	bool "detect HP by UEVENT(only for android)"
	
endchoice

config SUPPORT_AEC
	bool "Support Accoustic Echo Cancllation"
	depends on SND_AK_PCM
	help
		Support Accoustic Echo Cancllation.
	  	  
config SND_ARMAACI
	tristate "ARM PrimeCell PL041 AC Link support"
	depends on ARM_AMBA
	select SND_PCM
	select SND_AC97_CODEC

config SND_PXA2XX_PCM
	tristate
	select SND_PCM

config SND_PXA2XX_LIB
	tristate
	select SND_AC97_CODEC if SND_PXA2XX_LIB_AC97

config SND_PXA2XX_LIB_AC97
	bool

config SND_PXA2XX_AC97
	tristate "AC97 driver for the Intel PXA2xx chip"
	depends on ARCH_PXA
	select SND_PXA2XX_PCM
	select SND_AC97_CODEC
	select SND_PXA2XX_LIB
	select SND_PXA2XX_LIB_AC97
	help
	  Say Y or M if you want to support any AC97 codec attached to
	  the PXA2xx AC97 interface.

endif	# SND_ARM
```
